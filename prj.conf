## prj.conf
```kconfig
#CONFIG_NCS_SAMPLES_DEFAULTS
CONFIG_ASSERT=y
CONFIG_ASSERT_NO_COND_INFO=y
CONFIG_ASSERT_NO_MSG_INFO=y
CONFIG_RESET_ON_FATAL_ERROR=y

CONFIG_NCS_APPLICATION_BOOT_BANNER_STRING="SlimeVR-Tracker-nRF"
#CONFIG_NCS_BOOT_BANNER=n
CONFIG_BOOT_BANNER=n

CONFIG_LTO=y
CONFIG_ISR_TABLES_LOCAL_DECLARATION=y

CONFIG_ESB=y
#need to enable for nRF54L
#CONFIG_NRFX_DPPI10=y

CONFIG_ADC=y
CONFIG_ADC_NRFX_SAADC=y
CONFIG_FPU=y

# CMSIS-DSP Configuration for VQF optimization
CONFIG_CMSIS_DSP=y
CONFIG_CMSIS_DSP_FASTMATH=y
CONFIG_CMSIS_DSP_BASICMATH=y
CONFIG_CMSIS_DSP_MATRIX=y
CONFIG_CMSIS_DSP_QUATERNIONMATH=y
CONFIG_CMSIS_DSP_SUPPORT=y
CONFIG_CMSIS_DSP_CONTROLLER=y
CONFIG_DSP=y

CONFIG_I2C=y
CONFIG_SPI=y
CONFIG_PINCTRL=y

CONFIG_NVS=y
CONFIG_NVS_LOOKUP_CACHE=y
CONFIG_NVS_INIT_BAD_MEMORY_REGION=y

CONFIG_POWEROFF=y
CONFIG_REBOOT=y

CONFIG_FLASH=y
CONFIG_FLASH_PAGE_LAYOUT=y
CONFIG_FLASH_MAP=y

CONFIG_SETTINGS=y
CONFIG_SETTINGS_RUNTIME=y
CONFIG_SETTINGS_NONE=y

CONFIG_MPU_ALLOW_FLASH_WRITE=y

CONFIG_RETAINED_MEM=y

CONFIG_USE_SEGGER_RTT=y
CONFIG_LOG=y
#CONFIG_PRINTK=y
CONFIG_LOG_MODE_DEFERRED=y
CONFIG_LOG_SPEED=y
CONFIG_LOG_BACKEND_RTT=y
CONFIG_CBPRINTF_FP_SUPPORT=y
CONFIG_ADC_LOG_LEVEL_OFF=y
CONFIG_LOG_FUNC_NAME_PREFIX_ERR=y
CONFIG_LOG_BUFFER_SIZE=4096
CONFIG_LOG_BACKEND_UART_AUTOSTART=n
CONFIG_LOG_PROCESS_THREAD_SLEEP_MS=25
CONFIG_LOG_PROCESS_THREAD_STACK_SIZE=1024

CONFIG_PWM=y
CONFIG_GPIO=y

CONFIG_CRC=y

CONFIG_NEWLIB_LIBC=y
# CONFIG_NRFX_TIMER1=y

#speed up boot? (use internal rc oscillator)
CONFIG_CLOCK_CONTROL_NRF_K32SRC_RC=y
CONFIG_CLOCK_CONTROL_NRF_K32SRC_20PPM=y

# dont need it
CONFIG_CRYPTO=n

# set timeout for 25ms, sufficient for ~1000 bytes
CONFIG_I2C_NRFX_TRANSFER_TIMEOUT=25

CONFIG_USB_DEVICE_STACK_NEXT=y
CONFIG_USBD_CDC_ACM_CLASS=y
CONFIG_CDC_ACM_SERIAL_INITIALIZE_AT_BOOT=n
CONFIG_SLIMEVR_USB_DEVICE_VID=0x1209
CONFIG_SLIMEVR_USB_DEVICE_PID=0x7692
CONFIG_UART_INTERRUPT_DRIVEN=y

CONFIG_SERIAL=y
CONFIG_CONSOLE=y
CONFIG_RTT_CONSOLE=y
CONFIG_UART_CONSOLE=y
CONFIG_UART_LINE_CTRL=y

CONFIG_LOG=y
CONFIG_USBD_LOG_LEVEL_ERR=y
CONFIG_UDC_DRIVER_LOG_LEVEL_ERR=y
CONFIG_USBD_CDC_ACM_LOG_LEVEL_OFF=y

CONFIG_LOG_BACKEND_UART=y

CONFIG_CONSOLE_SUBSYS=y
CONFIG_CONSOLE_GETLINE=y

CONFIG_NVS_LOG_LEVEL_WRN=y

CONFIG_SYSTEM_WORKQUEUE_STACK_SIZE=512
CONFIG_MAIN_STACK_SIZE=2048
#crashing on nrf54l at 512

CONFIG_THREAD_NAME=y

# TODO: because of icm426, this will break things and needs to be raised to at least 3k
CONFIG_HEAP_MEM_POOL_SIZE=4096
CONFIG_ISR_STACK_SIZE=1024

CONFIG_PM_DEVICE=y


CONFIG_USE_ACTIVE_TIMEOUT=y

# 100ms switch delay will be obvious to users, so we choose not to use it by default,
# but it can be enabled for testing or specific use cases
CONFIG_SENSOR_USE_LOW_POWER_2=n

# enter low power as soon as VQF detects rest
CONFIG_USE_IMU_TIMEOUT=n
CONFIG_SENSOR_LP_TIMEOUT=0

# enter WOM as soon as possible during rest
CONFIG_ACTIVE_TIMEOUT_THRESHOLD=0
CONFIG_ACTIVE_TIMEOUT_DELAY=1000
CONFIG_USE_IMU_WAKE_UP=y

# or 6 hours timeout
# CONFIG_USE_IMU_WAKE_UP=n
# CONFIG_ACTIVE_TIMEOUT_DELAY=21600000

CONFIG_USER_EXTRA_ACTIONS=n
CONFIG_DISABLE_SENSOR_GPIOS_ON_SHUTDOWN=y

CONFIG_ESB_MAX_PAYLOAD_LENGTH=72
CONFIG_ESB_TX_FIFO_SIZE=8
CONFIG_ESB_RX_FIFO_SIZE=8
CONFIG_RADIO_RF_CHANNEL=0
CONFIG_RADIO_RETRANSMIT_DELAY=310
CONFIG_CONNECTION_ENABLE_ACK=n
CONFIG_RADIO_TX_POWER=8
# 3 minutes timeout after ping continuous failed
CONFIG_CONNECTION_TIMEOUT_DELAY=180000

CONFIG_SENSOR_USE_6_SIDE_CALIBRATION=n
CONFIG_SENSOR_USE_SENS_CALIBRATION=n
CONFIG_SENSOR_SENS_REV=5

CONFIG_SENSOR_USE_TCAL=y

# Boot calibration is disabled by default
# CONFIG_SENSOR_USE_BOOT_CALIBRATION=y

# Range statistics tracking (disabled by default to optimize performance)
# CONFIG_SENSOR_RANGE_STATS=y

# CONFIG_SENSOR_GYRO_ODR=400
# oversampling and odr settings
# icm45 800, dsv 960
CONFIG_SENSOR_GYRO_ODR=100
# icm45 ~200, dsv ~240
# CONFIG_SENSOR_GYRO_OVERSAMPLING=4
# icm45 800, dsv 960
CONFIG_SENSOR_ACCEL_ODR=50
# icm45 ~100, dsv ~120
# CONFIG_SENSOR_ACCEL_OVERSAMPLING=8
CONFIG_SENSOR_MAG_ODR=10
CONFIG_SENSOR_MAG_FIXED_ODR=y

# VQF experimental features
CONFIG_VQF_ADAPTIVE_TAU_ACC=n

# Watchdog Configuration
CONFIG_WATCHDOG=y
CONFIG_WDT_NRFX=y
CONFIG_TASK_WDT=y
CONFIG_TASK_WDT_CHANNELS=8
CONFIG_TASK_WDT_HW_FALLBACK=y
CONFIG_TASK_WDT_HW_FALLBACK_DELAY=5000

# enable tdma on board which don't have lfxo, it can use lf clock synthesized by hf clock,
# but it will increase a lot of power consumption, so if you want to use it, you can enable below config,
# or define it in board level Kconfig file.

# CONFIG_CLOCK_USE_LFXO=n
CONFIG_CONNECTION_TDMA=y

# Enable VQF benchmark mode for performance testing (disabled by default)
# CONFIG_VQF_BENCH=y
```

## src/retained.c
```c
/*
 * Copyright (c) 2021 Nordic Semiconductor ASA
 *
 * SPDX-License-Identifier: Apache-2.0
 */

#include "retained.h"

#include <stdint.h>
#include <string.h>

#include <zephyr/kernel.h>
#include <zephyr/devicetree.h>
#include <zephyr/drivers/retained_mem.h>
#include <zephyr/sys/byteorder.h>
#include <zephyr/sys/crc.h>

#include "build_defines.h"

#if DT_NODE_HAS_STATUS_OKAY(DT_ALIAS(retainedmemdevice))
#define MEMORY_REGION DT_PARENT(DT_ALIAS(retainedmemdevice))
#else
#error "retained_mem region not defined"
#endif

struct retained_data *retained = (struct retained_data *)DT_REG_ADDR(MEMORY_REGION);

#define RETAINED_CRC_OFFSET offsetof(struct retained_data, crc)
#define RETAINED_CHECKED_SIZE (RETAINED_CRC_OFFSET + sizeof(retained->crc))

static uint64_t init_time;

static int retained_init(void)
{
	init_time = k_uptime_ticks(); // Get current uptime in ticks as soon as possible
	return 0;
}

// TODO: priority?
SYS_INIT(retained_init, APPLICATION, CONFIG_APPLICATION_INIT_PRIORITY);

bool retained_validate(void)
{
	NRF_STATIC_ASSERT((RETAINED_CHECKED_SIZE <= 3072), "Retained data size exceeds 3 KB limit");

	uint64_t now = init_time;
//	uint64_t now = k_uptime_ticks(); // Get current uptime in ticks as soon as possible

	/* The residue of a CRC is what you get from the CRC over the
	 * message catenated with its CRC.  This is the post-final-xor
	 * residue for CRC-32 (CRC-32/ISO-HDLC) which Zephyr calls
	 * crc32_ieee.
	 */
	const uint32_t residue = 0x2144df1c;
	uint32_t crc = crc32_ieee((const uint8_t *)retained,
				  RETAINED_CHECKED_SIZE);
	bool valid = (crc == residue);

	/* Check the build timestamp of the firmware that last updated
	 * the retained data.
	 */
	valid &= (retained->build_timestamp == BUILD_TIMESTAMP);

	/* If the CRC isn't valid or the build timestamp is different
	 * from the current build timestamp, reset the retained data.
	 */
	if (!valid) {
		/* Clear entire retained data including watchdog_state when CRC/build_timestamp invalid
		 * (e.g., after firmware update). This ensures total_wdt_resets doesn't have garbage values.
		 */
		memset(retained, 0, sizeof(struct retained_data));
		retained->build_timestamp = BUILD_TIMESTAMP;

		#if CONFIG_SENSOR_USE_SENS_CALIBRATION
		retained->gyroSensScale[0] = 1.0f;
		retained->gyroSensScale[1] = 1.0f;
		retained->gyroSensScale[2] = 1.0f;
		#endif

		// Initialize battery tracker to invalid state (-1)
		retained->max_battery_pptt = -1;
		retained->min_battery_pptt = -1;
		retained->battery_pptt_saved = -1;
#if CONFIG_SENSOR_USE_TCAL
		// Initialize boot calibration state
		#ifdef CONFIG_SENSOR_USE_BOOT_CALIBRATION
		retained->bootCalState.enabled = true;
		#else
		retained->bootCalState.enabled = false;
		#endif
		retained->bootCalState.completed = false;
		retained->bootCalState.attempt_count = 0;
		retained->bootCalState.doffset_valid = false;
		retained->bootCalState.doffset[0] = 0.0f;
		retained->bootCalState.doffset[1] = 0.0f;
		retained->bootCalState.doffset[2] = 0.0f;
		retained->tcal_enabled = true; // T-Cal compensation enabled by default
#endif
		/* Initialize watchdog_state with valid magic but zero counters */
		retained->watchdog_state.magic = WATCHDOG_STATE_MAGIC;
		retained->watchdog_state.reset_count = 0;
		retained->watchdog_state.total_wdt_resets = 0;
		retained->watchdog_state.last_failed_channel = 0;
		retained->watchdog_state.last_reset_uptime = 0;
	}

	/* Reset to accrue runtime from this session. */
	retained->uptime_latest = now;
	retained->battery_uptime_latest = now;

	return valid;
}

void retained_update(void)
{
	uint64_t now = k_uptime_ticks();

	retained->uptime_sum += (now - retained->uptime_latest);
	retained->uptime_latest = now;

	uint32_t crc = crc32_ieee((const uint8_t *)retained,
				  RETAINED_CRC_OFFSET);

	retained->crc = sys_cpu_to_le32(crc);
}
```

## src/retained.h
```c
/*
 * Copyright (c) 2021 Nordic Semiconductor ASA
 *
 * SPDX-License-Identifier: Apache-2.0
 */

#ifndef RETAINED_H_
#define RETAINED_H_

#include <stdbool.h>
#include <stddef.h>
#include <stdint.h>

#if CONFIG_SENSOR_USE_TCAL
// A single point in temperature calibration data
struct TempCalPoint {
	float temp;    // The temperature for this point
	float bias[3]; // The gyro bias (x, y, z)
};
#endif

struct retained_data {
	/* The uptime from the current session the last time the
	 * retained data was updated.
	 */
	uint64_t uptime_latest;

	/* Cumulative uptime from all previous sessions up through
	 * uptime_latest of this session.
	 */
	uint64_t uptime_sum;

	/* The build version of the firmware that last updated the
	 * retained data.
	 */
	uint32_t build_timestamp;

	/* Battery statistics.  Tracking for discharge curve only begins
	 * after ~3% discharged.  If battery_pptt has changed significantly
	 * compared to min_battery_pptt since the last update,
	 * the statistics are cleared and may be saved to NVS.
	 */
	int16_t max_battery_pptt;
	int16_t min_battery_pptt;

	/* Battery uptime from last retained update */
	uint64_t battery_uptime_latest;

	/* Cumulative runtime */
	uint64_t battery_runtime_sum;

	/* Last interval stored in NVS */
	uint64_t battery_runtime_saved;
	int16_t battery_pptt_saved;

	/* Calibrated discharge curve */
	int16_t battery_pptt_curve[18];

	uint8_t reboot_counter;
	uint8_t paired_addr[8];

	uint8_t sensor_data[128];

	uint8_t fusion_id; // fusion_data_stored
	uint8_t fusion_data[800];

	float gyroBias[3];
	float magBAinv[4][3];

	#if CONFIG_SENSOR_USE_6_SIDE_CALIBRATION
	float accBAinv[4][3];
	#endif

	#if CONFIG_SENSOR_USE_SENS_CALIBRATION
	float gyroSensScale[3]; // Gyro sensitivity
	#endif

	uint16_t imu_addr;
	uint16_t mag_addr;

	uint8_t imu_reg;
	uint8_t mag_reg;

	uint8_t rf_channel; // RF channel (0-100), 0xFF means use default

	bool mag_enabled;

	// Online magnetometer calibration runtime state.
	// Persists across WoM resumes so online mag cal does not re-enter
	// early bootstrap after every wake, but is cleared on full reboot/shutdown.
	struct {
		float last_buf_avg_norm;
		uint8_t update_count;
		uint8_t reserved[3];
	} onlineMagState;

#if CONFIG_SENSOR_USE_TCAL
	bool tcal_enabled; // Temperature calibration compensation enabled
	float gyroTemp;

	#define TCAL_BUFFER_SIZE                                                                                               \
		(int)((CONFIG_SENSOR_POLY_TEMP_MAX - CONFIG_SENSOR_POLY_TEMP_MIN) * CONFIG_SENSOR_POLY_STEPS_PER_DEGREE)
		struct TempCalPoint tempCalPoints[TCAL_BUFFER_SIZE];
	float tempCalCoeffs[3][CONFIG_SENSOR_POLY_DEGREE + 1];
	float tempCalCorrectionOffset[3];

	struct {
		uint16_t count;
		bool valid;
		uint8_t degree;
	} tempCalState;

	// Boot calibration state (runtime only, persists in WoM but resets on full reboot)
	struct {
		bool enabled;              // Feature enabled
		bool completed;            // Completed for this boot
		uint8_t attempt_count;     // Number of attempts
		bool doffset_valid;        // D_offset is valid
		float doffset[3];          // Calculated D_offset (runtime only)
	} bootCalState;
#endif

	/* CRC used to validate the retained data.  This must be
	 * stored little-endian, and covers everything up to but not
	 * including this field.
	 */
	uint32_t crc;

	/* ==== FIELDS BELOW ARE NOT INCLUDED IN CRC CALCULATION ==== */
	/* These fields are intentionally placed after the CRC so they can
	 * be modified without invalidating the CRC. This is important for
	 * watchdog state which must persist across unexpected resets.
	 */

	// Watchdog state (persists across WDT resets, outside CRC validation)
	struct {
		uint8_t reset_count;           // WDT consecutive reset count
		uint8_t last_failed_channel;   // Last channel that failed to feed
		uint32_t last_reset_uptime;    // System uptime at last WDT reset (ms)
		uint32_t total_wdt_resets;     // Cumulative WDT reset count (for debugging)
		uint32_t magic;                // Magic number to validate watchdog state
	} watchdog_state;
};

/* Magic number to validate watchdog state */
#define WATCHDOG_STATE_MAGIC 0x57445447  /* "WDTG" in ASCII */

/* Up to 4 KB of retained data allowed right now.
 */
#define RETAINED_SIZE (sizeof(struct retained_data))

/* For simplicity in the sample just allow anybody to see and
 * manipulate the retained state.
 */
extern struct retained_data *retained;

/* Check whether the retained data is valid, and if not reset it.
 *
 * @return true if and only if the data was valid and reflects state
 * from previous sessions.
 */
bool retained_validate(void);

/* Update any generic retained state and recalculate its checksum so
 * subsequent boots can verify the retained state.
 */
void retained_update(void);

#endif /* RETAINED_H_ */
```
